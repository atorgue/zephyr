## boards/arm/stm32mp157c_dk2/stm32mp157c_dk2_defconfig
```kconfig
CONFIG_ARM=y
CONFIG_BOARD_STM32MP157C_DK2=y
CONFIG_SOC_SERIES_STM32MP1X=y
CONFIG_SOC_STM32MP15_M4=y
CONFIG_CORTEX_M_SYSTICK=y
# 80MHz system clock
CONFIG_SYS_CLOCK_HW_CYCLES_PER_SEC=80000000

# clock configuration
CONFIG_CLOCK_CONTROL=n
# SYSCLK selection
#CONFIG_CLOCK_STM32_SYSCLK_SRC_PLL=y
# PLL configuration
#CONFIG_CLOCK_STM32_PLL_SRC_HSI=y
# produce 80MHz clock at PLL output
#CONFIG_CLOCK_STM32_PLL_M_DIVISOR=1
#CONFIG_CLOCK_STM32_PLL_N_MULTIPLIER=20
#CONFIG_CLOCK_STM32_PLL_P_DIVISOR=7
#CONFIG_CLOCK_STM32_PLL_Q_DIVISOR=2
#CONFIG_CLOCK_STM32_PLL_R_DIVISOR=4
#CONFIG_CLOCK_STM32_AHB_PRESCALER=1
#CONFIG_CLOCK_STM32_APB1_PRESCALER=1
#CONFIG_CLOCK_STM32_APB2_PRESCALER=1


#remote proc console
CONFIG_CONSOLE=y
CONFIG_RAM_CONSOLE=y
CONFIG_RAM_CONSOLE_BUFFER_SIZE=1024
CONFIG_SOC_STM32MP15_RPROC_RSC_TABLE=y
```

## soc/arm/st_stm32/stm32mp1/Kconfig.defconfig.stm32mp15_m4
```kconfig
# Kconfig - ST Microelectronics STM32MP157C_M4 MCU
#
# # Copyright (c) 2019 ST Microelectronics Limited
#
# SPDX-License-Identifier: Apache-2.0
#

if SOC_STM32MP15_M4

config SOC
	string
	default "stm32mp157cxx"

config NUM_IRQS
	int
	default 150
#APO: to update IRQ num

endif # SOC_STM32MP15_M4
```

## soc/arm/st_stm32/stm32mp1/Kconfig.series
```kconfig
# Kconfig - ST Microelectronics STM32MP1 MPU series
#
# Copyright (c) 2019 ST Microelectronics Limited
#
# SPDX-License-Identifier: Apache-2.0
#

config SOC_SERIES_STM32MP1X
	bool "STM32MP15 Series MPU"
	select CPU_CORTEX_M4
	select SOC_FAMILY_STM32
	select SYS_POWER_LOW_POWER_STATE_SUPPORTED
	select HAS_STM32CUBE
	select CPU_HAS_ARM_MPU
	select CPU_HAS_SYSTICK
	select CLOCK_CONTROL_STM32_CUBE if CLOCK_CONTROL
	help
		Enable support for STM32MP1 MPU series
```

## soc/arm/st_stm32/stm32mp1/Kconfig.soc
```kconfig
# Kconfig - ST Microelectronics STM32MP1 MPU line
#
# Copyright (c) 2019 ST Microelectronics Limited
#
# SPDX-License-Identifier: Apache-2.0
#

choice
prompt "STM32MP1 MPU Selection"
depends on SOC_SERIES_STM32MP1X

config SOC_STM32MP15_M4
	bool "STM32MP15_M4"

endchoice

config SOC_STM32MP15_RPROC_RSC_TABLE
	bool "coprocessor resource table"
	default n
	help
	  add the resource table in the generated binary. This table is 
	  compatible with linux remote proc framework and OpenAMP library.
```
